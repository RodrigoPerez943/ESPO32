#include <Wire.h>
#include <Adafruit_GFX.h>
#include <Adafruit_SSD1306.h>
#include <WiFi.h>
#include <NTPClient.h>
#include <WiFiUdp.h>
#include <HTTPClient.h>
#include <ArduinoJson.h>
#include <StateMachine.h>
#include <SpotifyArduinoCert.h>
#include <SpotifyArduino.h>
#include <WiFiClientSecure.h>
#include "AiEsp32RotaryEncoder.h"
#include <gfxfont.h>

// Definir el ancho y alto de la pantalla OLED
#define SCREEN_WIDTH 128
#define SCREEN_HEIGHT 64

#define SCREEN_HEIGHT2 32

// 25 BOTON

// Definir pines de conexión para el ESP32
#define OLED_SDA 22
#define OLED_SCL 23

#define FRAME_WIDTH (64)
#define FRAME_HEIGHT (64)
#define FRAME_COUNT (sizeof(frames) / sizeof(frames[0]))

#define FRAME_DELAY2 (42)
#define FRAME_WIDTH2 (32)
#define FRAME_HEIGHT2 (32)
#define FRAME_COUNT2 (sizeof(frames2) / sizeof(frames2[0]))

#define ROTARY_ENCODER_A_PIN 27 //DT
#define ROTARY_ENCODER_B_PIN 26 // CLK
#define ROTARY_ENCODER_BUTTON_PIN 21 //SW
#define ROTARY_ENCODER_VCC_PIN -1
#define ROTARY_ENCODER_STEPS 4

const byte PROGMEM frames[][512] = {
  {0,0,0,0,0,0,0,0,0,0,0,0,0,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0,0},
  {0,0,0,0,0,0,0,0,0,0,0,0,0,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0,0},
  {0,0,0,0,0,0,0,0,0,0,0,0,0,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0,0},
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  {0,0,0,0,0,0,0,0,0,0,0,0,0,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0,0}
};

const byte PROGMEM frames2[][128] = {
  {0,0,0,0,0,0,0,96,0,0,1,248,0,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0,0},
  {0,0,0,0,0,0,0,96,0,0,1,248,0,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0,0},
  {0,0,0,0,0,0,0,96,0,0,1,248,0,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0,0},
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  {0,0,0,0,0,0,0,96,0,0,1,248,0,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0,0}
};

// 'mext-selected', 128x32px
const unsigned char epd_bitmap_mext_selected [] PROGMEM = {
	0x00, 0x00, 0x00, 0x00, 0x00, 0x00, 0x00, 0x00, 0x00, 0x00, 0x00, 0x00, 0x00, 0x00, 0x00, 0x00, 
	0x00, 0x00, 0x00, 0x00, 0x00, 0x00, 0x00, 0x00, 0x00, 0x00, 0x00, 0x00, 0x00, 0x00, 0x00, 0x00, 
	0x00, 0x00, 0x00, 0x00, 0x00, 0x00, 0x00, 0x00, 0x00, 0x00, 0x00, 0x00, 0x00, 0x00, 0x00, 0x00, 
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	0x00, 0x00, 0x00, 0x00, 0x00, 0x00, 0x00, 0x00, 0x00, 0x00, 0x00, 0x00, 0x00, 0x00, 0x00, 0x00
};
// 'pause-selected', 128x32px
const unsigned char epd_bitmap_pause_selected [] PROGMEM = {
	0x00, 0x00, 0x00, 0x00, 0x00, 0x00, 0x00, 0x00, 0x00, 0x00, 0x00, 0x00, 0x00, 0x00, 0x00, 0x00, 
	0x00, 0x00, 0x00, 0x00, 0x00, 0x00, 0x00, 0x00, 0x00, 0x00, 0x00, 0x00, 0x00, 0x00, 0x00, 0x00, 
	0x00, 0x00, 0x00, 0x00, 0x00, 0x00, 0x00, 0x00, 0x00, 0x00, 0x00, 0x00, 0x00, 0x00, 0x00, 0x00, 
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	0x00, 0x00, 0x00, 0x00, 0x00, 0x00, 0x00, 0x00, 0x00, 0x00, 0x00, 0x00, 0x00, 0x00, 0x00, 0x00
};
// 'playnshit', 128x32px
const unsigned char epd_bitmap_playnshit [] PROGMEM = {
	0x00, 0x00, 0x00, 0x00, 0x00, 0x00, 0x00, 0x00, 0x00, 0x00, 0x00, 0x00, 0x00, 0x00, 0x00, 0x00, 
	0x00, 0x00, 0x00, 0x00, 0x00, 0x00, 0x00, 0x00, 0x00, 0x00, 0x00, 0x00, 0x00, 0x00, 0x00, 0x00, 
	0x00, 0x00, 0x00, 0x00, 0x00, 0x00, 0x00, 0x00, 0x00, 0x00, 0x00, 0x00, 0x00, 0x00, 0x00, 0x00, 
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	0x00, 0x00, 0x00, 0x00, 0x00, 0x00, 0x00, 0x00, 0x00, 0x00, 0x00, 0x00, 0x00, 0x00, 0x00, 0x00
};
// 'play-selected', 128x32px
const unsigned char epd_bitmap_play_selected [] PROGMEM = {
	0x00, 0x00, 0x00, 0x00, 0x00, 0x00, 0x00, 0x00, 0x00, 0x00, 0x00, 0x00, 0x00, 0x00, 0x00, 0x00, 
	0x00, 0x00, 0x00, 0x00, 0x00, 0x00, 0x00, 0x00, 0x00, 0x00, 0x00, 0x00, 0x00, 0x00, 0x00, 0x00, 
	0x00, 0x00, 0x00, 0x00, 0x00, 0x00, 0x00, 0x00, 0x00, 0x00, 0x00, 0x00, 0x00, 0x00, 0x00, 0x00, 
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	0x00, 0x00, 0x00, 0x00, 0x00, 0x00, 0x00, 0x00, 0x00, 0x00, 0x00, 0x00, 0x00, 0x00, 0x00, 0x00
};
// 'previous-selected', 128x32px
const unsigned char epd_bitmap_previous_selected [] PROGMEM = {
	0x00, 0x00, 0x00, 0x00, 0x00, 0x00, 0x00, 0x00, 0x00, 0x00, 0x00, 0x00, 0x00, 0x00, 0x00, 0x00, 
	0x00, 0x00, 0x00, 0x00, 0x00, 0x00, 0x00, 0x00, 0x00, 0x00, 0x00, 0x00, 0x00, 0x00, 0x00, 0x00, 
	0x00, 0x00, 0x00, 0x00, 0x00, 0x00, 0x00, 0x00, 0x00, 0x00, 0x00, 0x00, 0x00, 0x00, 0x00, 0x00, 
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	0x00, 0x00, 0x00, 0x00, 0x00, 0x00, 0x00, 0x00, 0x00, 0x00, 0x00, 0x00, 0x00, 0x00, 0x00, 0x00
};

// Array of all bitmaps for convenience. (Total bytes used to store images in PROGMEM = 2640)
const int epd_bitmap_allArray_LEN = 5;
const unsigned char* epd_bitmap_allArray[5] = {
	epd_bitmap_mext_selected,
	epd_bitmap_pause_selected,
	epd_bitmap_play_selected,
	epd_bitmap_playnshit,
	epd_bitmap_previous_selected
};


// Crear una instancia de la pantalla
Adafruit_SSD1306 display1(SCREEN_WIDTH, SCREEN_HEIGHT, &Wire, -1);
Adafruit_SSD1306 display2(SCREEN_WIDTH, SCREEN_HEIGHT2, &Wire, -1);


//Crear instancia del knob
AiEsp32RotaryEncoder rotaryEncoder = AiEsp32RotaryEncoder(ROTARY_ENCODER_A_PIN, ROTARY_ENCODER_B_PIN, ROTARY_ENCODER_BUTTON_PIN, ROTARY_ENCODER_VCC_PIN, ROTARY_ENCODER_STEPS);


char ssid[] = "";         // your network SSID (name)
char password[] = ""; // your network password

// Clave de API de OpenWeatherMap
const char* apiKey = ""; // Reemplaza con tu clave de API de OpenWeatherMap
const char* weatherApiUrl = "";

// Spotify
char clientId[] = "";     // Your client ID of your spotify APP
char clientSecret[] = ""; // Your client Secret of your spotify APP (Do Not share this!)
#define SPOTIFY_MARKET "ES"
#define SPOTIFY_REFRESH_TOKEN ""

WiFiClientSecure client;
SpotifyArduino spotify(client, clientId, clientSecret, SPOTIFY_REFRESH_TOKEN);

unsigned long delayBetweenRequests = 60000; // Time between requests (1 minute)
unsigned long requestDueTime;               //time when request due

// Crear una instancia del cliente NTP
WiFiUDP ntpUDP;
NTPClient timeClient(ntpUDP, "pool.ntp.org", 3600 * 2, 60000); // Actualizar cada 60 segundos
int frame = 0;

// Definir Máquina de Estados
StateMachine machine = StateMachine();

State* S0 = machine.addState(&state0); 
State* S1 = machine.addState(&state1);

//Definir variables
int act = 60;
float temp = 0.0;
float tempMin = 0.0;
float tempMax = 0.0;
int frameOffset = 0; // Variable para el desplazamiento del marco
bool direction = true; // Dirección del movimiento del marco
int actTime = 4;
int cambioEstado = 0;
String formattedTime = "Null";
bool wifiConnected = false;

String lastSong = "";
String lastSongUri = "";
String lastAlbum = "";
String lastArtist = "";
long progreso = 0;
long duracion = 0;

int textX_song = SCREEN_WIDTH;
int textX_album = SCREEN_WIDTH;
int textX_artist = SCREEN_WIDTH;

volatile int encoderValue = 0; // Valor del encoder
volatile int lastEncoded = 0;  // Estado anterior del encoder
volatile bool buttonPressed = false; // Estado del botón
volatile unsigned long lastDebounceTime = 0; // Última vez que se detectó una pulsación
const unsigned long debounceDelay = 50; // Tiempo de debounce en milisegundos
int lastEncoderRegister = 0;

int volumenActual = 0;
bool cambioVol = false;
int tiempoCheckvol = 0;

const int PAUSE_INDEX = 1;
const int PLAY_INDEX = 2;
const int NEXT_INDEX = 0;
const int PREVIOUS_INDEX = 4;
int currentGlyphIndex = PLAY_INDEX;  // Comenzamos en 'play-selected'

// Select I2C BUS
void TCA9548A(uint8_t bus) {
  Wire.beginTransmission(0x70);  // TCA9548A address
  Wire.write(1 << bus);          // send byte to select bus
  Wire.endTransmission();
  // Serial.print("Bus: ");
  // Serial.println(bus);
}

unsigned long lastDebounceTime1 = 0;
bool buttonPressed1 = false;

bool buttonTrue() {
  bool reading = digitalRead(25);
  if (reading != buttonPressed1) {
    lastDebounceTime1 = millis();
  }

  if (((millis() - lastDebounceTime1) > 100) && reading == true) {
    Serial.println((millis() - lastDebounceTime1));
    buttonPressed1 = reading; 
    Serial.println("Cambio de estado");
    cambioEstado = 1; // Marca el cambio de estado
    lastDebounceTime1 = millis();
    return true; 
    }
  
  cambioEstado = 0;
  buttonPressed1 = reading;
  return false; 
}

void simboloLateral(){
  TCA9548A(4);
  static int frame2 = 0;
  display2.clearDisplay();
  display2.drawBitmap(48, 0, frames2[frame2], FRAME_WIDTH2, FRAME_HEIGHT2, 1);
  display2.display();
  frame2 = (frame2 + 1) % FRAME_COUNT2;
  TCA9548A(7);
}

void mostrarSimboloCarga(){
      display1.clearDisplay();
      display1.drawBitmap(32, 0, frames[frame], FRAME_WIDTH, FRAME_HEIGHT, 1);
      display1.display();
      frame = (frame + 1) % FRAME_COUNT;
      delay(42);
}

void mostrarMensajeError(){
    display1.clearDisplay();
    display1.setTextSize(1);
    display1.setTextColor(SSD1306_WHITE);
    display1.setCursor(0, 20);
    display1.println("Error: No se pudo conectar aL WIFI :(.");
    display1.display();
}

void moverMarco(){

    // Dibujar el marco de líneas discontinuas en movimiento
    for (int i = 0; i < SCREEN_WIDTH; i += 4) {
        display1.drawPixel((i + frameOffset) % SCREEN_WIDTH, 0, SSD1306_WHITE); // Parte superior
        display1.drawPixel((i + frameOffset) % SCREEN_WIDTH, SCREEN_HEIGHT - 1, SSD1306_WHITE); // Parte inferior
    }
    for (int i = 0; i < SCREEN_HEIGHT; i += 4) {
        display1.drawPixel(0, (i + frameOffset) % SCREEN_HEIGHT, SSD1306_WHITE); // Izquierda
        display1.drawPixel(SCREEN_WIDTH - 1, (i + frameOffset) % SCREEN_HEIGHT, SSD1306_WHITE); // Derecha
    }

    // Actualizar la pantalla para mostrar el nuevo contenido
    display1.display();

    // Actualizar el desplazamiento del marco
    frameOffset = (frameOffset + 1) % 4;
}

String generateProgressBar(int segments) {
  String progressBar = " |";
  for (int i = 0; i < 6; i++) {
    if (i < segments) {
      progressBar += "="; // Mostrar el segmento lleno
    } else {
      progressBar += "-"; // Mostrar el segmento vacío
    }
  }
  progressBar += "| ";
  return progressBar;
}

void setSpot() {
  playSpot();
  pauseSpot();
  nextTrackSpot();
  previousTrackSpot();
  display1.clearDisplay();
  int16_t x1, y1;
  uint16_t w, h;
  // Mostrar la canción
  String Cancion = String(removeTildes(lastSong));
  display1.getTextBounds(Cancion, 0, 0, &x1, &y1, &w, &h);
  if (w > SCREEN_WIDTH - 4) {
    display1.setTextWrap(false);
    display1.setCursor(textX_song , 10);
    textX_song -= 1;
    if (textX_song < -(w + w/2)) {
      textX_song = SCREEN_WIDTH;
    }
  } else {
    display1.setTextWrap(true);
    display1.setCursor((SCREEN_WIDTH - w) / 2, 10);
  }
  display1.print(Cancion);

  // Mostrar el artista
  String Cantante = String(removeTildes(lastArtist));
  display1.getTextBounds(Cantante, 0, 0, &x1, &y1, &w, &h);
  if (w > SCREEN_WIDTH - 4) {
    display1.setTextWrap(false);
    display1.setCursor(textX_artist, 22);
    textX_artist -= 1;
    if (textX_artist < -(w + w/2)) {
      textX_artist = SCREEN_WIDTH;
    }
  } else {
    display1.setTextWrap(true);
    display1.setCursor((SCREEN_WIDTH - w) / 2, 22);
  }
  display1.print(Cantante);

  // Mostrar el álbum
  String Album = String(removeTildes(lastAlbum));
  display1.getTextBounds(Album, 0, 0, &x1, &y1, &w, &h);
  if (w > SCREEN_WIDTH - 4) {
    display1.setTextWrap(false);
    display1.setCursor(textX_album, 34);
    textX_album -= 1;
    if (textX_album < -(w + w/2)) {
      textX_album = SCREEN_WIDTH;
    }
  } else {
    display1.setTextWrap(true);
    display1.setCursor((SCREEN_WIDTH - w) / 2, 34);
  }
  display1.print(Album);

  // Mostrar tiempo
  int numerosegmentos = map(progreso, 0, duracion, 0, 6);
  String progressBar = convertMsToMMSS(progreso) + generateProgressBar(numerosegmentos) + convertMsToMMSS(duracion);
  display1.getTextBounds(progressBar, 0, 0, &x1, &y1, &w, &h);
  display1.setTextWrap(true);
  display1.setCursor((SCREEN_WIDTH - w) / 2, 50);
  display1.print(progressBar);

  // 
  display1.setTextWrap(true);
}

void printCurrentlyPlayingToSerial(CurrentlyPlaying currentlyPlaying){

    if (currentlyPlaying.isPlaying && currentlyPlaying.trackName != lastSong){
      lastSong = currentlyPlaying.trackName;
      lastArtist = currentlyPlaying.artists[0].artistName;
      lastAlbum = currentlyPlaying.albumName;
      duracion = currentlyPlaying.durationMs;
    }
    if (currentlyPlaying.isPlaying){
      progreso = currentlyPlaying.progressMs;
    }
    else if (!currentlyPlaying.isPlaying){
    lastSong = "";
    lastArtist = "Nada en PLAY :)";
    lastAlbum = "";
    duracion = 0;
    progreso = 0;
    }

}

void printPlayerDetailsToSerial(PlayerDetails playerDetails){
  volumenActual = playerDetails.device.volumePercent;
}

String convertMsToMMSS(unsigned long milliseconds) {
  unsigned long totalSeconds = milliseconds / 1000;
  unsigned int minutes = totalSeconds / 60;
  unsigned int seconds = totalSeconds % 60;

  String formattedTime = "";
  if (minutes < 10) formattedTime += "0";
  formattedTime += String(minutes) + ":";
  if (seconds < 10) formattedTime += "0";
  formattedTime += String(seconds);

  return formattedTime;
}

String removeTildes(String text) {
  text.replace("á", "a");
  text.replace("é", "e");
  text.replace("í", "i");
  text.replace("ñ", "n");
  text.replace("ó", "o");
  text.replace("ú", "u");
  text.replace("Á", "A");
  text.replace("É", "E");
  text.replace("Í", "I");
  text.replace("Ó", "O");
  text.replace("Ú", "U");
  return text;
}

void IRAM_ATTR handleEncoderInterrupt() {
  int MSB = digitalRead(ROTARY_ENCODER_A_PIN); // MSB = most significant bit
  int LSB = digitalRead(ROTARY_ENCODER_B_PIN); // LSB = least significant bit

  int encoded = (MSB << 1) | LSB; // Construir un valor entero a partir de los bits A y B
  int sum = (lastEncoded << 2) | encoded; // Crear un valor combinando el estado anterior y el actual

  // Determinar la dirección del giro
  if (sum == 0b1101 || sum == 0b0100 || sum == 0b0010 || sum == 0b1011) encoderValue++;
  if (sum == 0b1110 || sum == 0b0111 || sum == 0b0001 || sum == 0b1000) encoderValue--;

  lastEncoded = encoded; // Actualizar el estado anterior con el actual
  cambioVol = true;
}

void IRAM_ATTR handleButtonInterrupt() {
  unsigned long currentTime = millis();
  // Verificar si el tiempo desde la última pulsación es suficiente para considerar un debounce
  if ((currentTime - lastDebounceTime) > debounceDelay) {
    buttonPressed = true;
    lastDebounceTime = currentTime;
  }
}

void previousTrackSpot(){
  if(buttonPressed && currentGlyphIndex == 4){
    spotify.previousTrack();
    spotify.getCurrentlyPlaying(printCurrentlyPlayingToSerial, SPOTIFY_MARKET);
    buttonPressed = false;
  }
}

void nextTrackSpot(){
  if(buttonPressed && currentGlyphIndex == 0){
    spotify.nextTrack();
    spotify.getCurrentlyPlaying(printCurrentlyPlayingToSerial, SPOTIFY_MARKET);
    buttonPressed = false;
  }
}

void pauseSpot(){
  if(buttonPressed && currentGlyphIndex == 1){
    spotify.pause();
    spotify.getCurrentlyPlaying(printCurrentlyPlayingToSerial, SPOTIFY_MARKET);
    buttonPressed = false;
  }
}

void playSpot(){
  if(buttonPressed && currentGlyphIndex == 2){
    spotify.play();
    spotify.getCurrentlyPlaying(printCurrentlyPlayingToSerial, SPOTIFY_MARKET);
    buttonPressed = false;
  }
}

void setVolumeSpot(){

  if (lastEncoderRegister > encoderValue && ((volumenActual - 5) >= 0)){
    volumenActual -= 5;
    spotify.setVolume(volumenActual);
    lastEncoderRegister = encoderValue;
    cambioVol = false;
  }
  else if (lastEncoderRegister < encoderValue && ((volumenActual + 5) <= 100)){
    volumenActual += 5;
    spotify.setVolume(volumenActual);
    lastEncoderRegister = encoderValue;
    cambioVol = false;
  }
  else if(lastEncoderRegister < encoderValue && (volumenActual + 5) > 100 && volumenActual != 100){
    volumenActual = 100;
    spotify.setVolume(volumenActual);
    lastEncoderRegister = encoderValue;
    cambioVol = false;
  }
  else if( lastEncoderRegister > encoderValue && (volumenActual - 5) < 0 && volumenActual != 0){
    volumenActual = 0;
    spotify.setVolume(volumenActual);
    lastEncoderRegister = encoderValue;
    cambioVol = false;
  }
  cambioVol = false;

}

void secondStatePantalla2(){
  if (encoderValue > lastEncoderRegister + 3) {
        TCA9548A(4);
        display2.clearDisplay();
        // Mover hacia adelante
        switch (currentGlyphIndex) {
            case PAUSE_INDEX:
                currentGlyphIndex = PLAY_INDEX;
                break;
            case PLAY_INDEX:
                currentGlyphIndex = NEXT_INDEX;
                break;
            case NEXT_INDEX:
                currentGlyphIndex = PREVIOUS_INDEX;
                break;
            case PREVIOUS_INDEX:
                currentGlyphIndex = PAUSE_INDEX;
                break;
        }
        lastEncoderRegister = encoderValue;
        mostrarBitmap(currentGlyphIndex);
    } else if (encoderValue < lastEncoderRegister - 3) {
        // Mover hacia atrás
        TCA9548A(4);
        display2.clearDisplay();
        switch (currentGlyphIndex) {
            case PAUSE_INDEX:
                currentGlyphIndex = PREVIOUS_INDEX;
                break;
            case PLAY_INDEX:
                currentGlyphIndex = PAUSE_INDEX;
                break;
            case NEXT_INDEX:
                currentGlyphIndex = PLAY_INDEX;
                break;
            case PREVIOUS_INDEX:
                currentGlyphIndex = NEXT_INDEX;
                break;
        }
        lastEncoderRegister = encoderValue;
        mostrarBitmap(currentGlyphIndex);
    }

    TCA9548A(7);
}

void mostrarBitmap(int index) {
    display2.clearDisplay();
    display2.drawBitmap(0, 0, epd_bitmap_allArray[index], SCREEN_WIDTH, SCREEN_HEIGHT2, SSD1306_WHITE);
    display2.display();
    Serial.print("Mostrar bitmap índice: ");
    Serial.println(index);
}

void state0(){

    static int tiempoLat = 0;
    static int tiempoS0 = 0;
    cambioVol = false;

    if (millis() - tiempoLat > 20 ){
      simboloLateral();
      tiempoLat = millis();
    }  

    if (millis() - tiempoS0 > 250 ){
      //Serial.println(encoderValue);
      if (actTime == 4 || cambioEstado == 1){
          // Obtener la hora actual del servidor NTP
          buttonPressed = 0;
          timeClient.update();
          formattedTime = timeClient.getFormattedTime();
          actTime = 0;
      }
      // Limpiar la pantalla
      display1.clearDisplay();

      if ((WiFi.status() == WL_CONNECTED) && act >= 60) { // Verificar conexión WiFi
          temp = 0;
          HTTPClient http;
          http.begin(weatherApiUrl); // Especificar URL
          int httpCode = http.GET(); // Hacer solicitud GET

          if (httpCode > 0) { // Verificar el código de estado HTTP
              String payload = http.getString();
              Serial.println(payload); // Imprimir carga útil de la respuesta

              // Parsear JSON
              DynamicJsonDocument doc(1024);
              deserializeJson(doc, payload);

              temp = doc["main"]["temp"];
              tempMin = doc["main"]["temp_min"];
              tempMax = doc["main"]["temp_max"];
          }

          http.end(); // Cerrar conexión
          act = 0;
      }

      // Dibujar el marco de líneas discontinuas en movimiento
      for (int i = 0; i < SCREEN_WIDTH; i += 4) {
          display1.drawPixel((i + frameOffset) % SCREEN_WIDTH, 0, SSD1306_WHITE); // Parte superior
          display1.drawPixel((i + frameOffset) % SCREEN_WIDTH, SCREEN_HEIGHT - 1, SSD1306_WHITE); // Parte inferior
      }
      for (int i = 0; i < SCREEN_HEIGHT; i += 4) {
          display1.drawPixel(0, (i + frameOffset) % SCREEN_HEIGHT, SSD1306_WHITE); // Izquierda
          display1.drawPixel(SCREEN_WIDTH - 1, (i + frameOffset) % SCREEN_HEIGHT, SSD1306_WHITE); // Derecha
      }

      // Configurar el tamaño y color del texto
      display1.setTextSize(1);
      display1.setTextColor(SSD1306_WHITE);

      // Calcular las posiciones centradas
      int16_t x1, y1;
      uint16_t w, h;

      // Mostrar la hora centrada
      String timeText = formattedTime;
      display1.getTextBounds(timeText, 0, 0, &x1, &y1, &w, &h);
      display1.setCursor((SCREEN_WIDTH - w - 4 ) / 2, 8);
      display1.println(timeText);

      // Mostrar la temperatura actual centrada
      String tempText = "Temp: " + String(temp) + " C";
      display1.getTextBounds(tempText, 0, 0, &x1, &y1, &w, &h);
      display1.setCursor((SCREEN_WIDTH - w - 4 ) / 2, 22);
      display1.println(tempText);

      // Mostrar la temperatura máxima centrada
      String maxText = "Max:  " + String(tempMax) + " C";
      display1.getTextBounds(maxText, 0, 0, &x1, &y1, &w, &h);
      display1.setCursor((SCREEN_WIDTH - w - 4 ) / 2, 34);
      display1.println(maxText);

      // Mostrar la temperatura mínima centrada
      String minText = "Min:  " + String(tempMin) + " C";
      display1.getTextBounds(minText, 0, 0, &x1, &y1, &w, &h);
      display1.setCursor((SCREEN_WIDTH - w - 4 ) / 2, 46);
      display1.println(minText);

      // Actualizar la pantalla para mostrar el nuevo contenido
      display1.display();

      // Actualizar el desplazamiento del marco
      frameOffset = (frameOffset + 1) % 4;

      // Esperar un segundo antes de la siguiente actualización
      act += 1;
      actTime += 1;

      // Serial.println(encoderValue);
      // if (buttonPressed){
      //   Serial.println(buttonPressed);
      //   buttonPressed = false;
      // }
      tiempoS0 = millis();
    }
}

void state1(){
  static int tiempoestado1 = 0;
  static int tiempopantalla = 0;
  static int tiempoScroll = 0;
  static int tiempoGiro = 0;

  if(cambioEstado == 1){
    TCA9548A(4);
    mostrarBitmap(currentGlyphIndex);
    cambioEstado = 0;
    TCA9548A(7);
  }
  if(cambioVol && (millis() - tiempoGiro > 100)){
    secondStatePantalla2();
    tiempoGiro = millis();
    cambioVol = false;
  }
  

  if (millis() - tiempoCheckvol > 300000){ // Cada 5 mins checkea el volumen
      // Serial.print("Obteniendo estado de Play");
      spotify.getPlayerDetails(printPlayerDetailsToSerial, SPOTIFY_MARKET);    
      tiempoCheckvol = millis();
  }

  // if(cambioVol){
  //   if (volumenActual != 100 || volumenActual != 0){
  //     setVolumeSpot();
  //   }
  //   else{
  //     cambioVol = false;
  //   }
  // }

  if (millis() - tiempoestado1 > 5000 || tiempoestado1 == 0){
    int status = spotify.getCurrentlyPlaying(printCurrentlyPlayingToSerial, SPOTIFY_MARKET);
    if (status == 200){
        Serial.println("Successfully got currently playing");
    }
    else if (status == 204){
        Serial.println("Doesn't seem to be anything playing");
        lastArtist = "Nada en PLAY :)";
    }
    else{
        Serial.print("Error: ");
        Serial.println(status);
    }
    tiempoestado1 = millis();
  }

  if (millis() - tiempoScroll > 50 || tiempoScroll == 0){
    // Serial.println("Actualizando pantalla");
    setSpot();
    tiempoScroll = millis();
  }
  if(millis() - tiempopantalla > 250 || tiempopantalla == 0 ){
    // Serial.println("Moviendo Marco");
    moverMarco();
    tiempopantalla = millis();
  }

  
}

void setup() {
    Serial.begin(115200);

    // Definir transiciones
    S0->addTransition(&buttonTrue, S1);
    S1->addTransition(&buttonTrue, S0);

    // Botón cambio de Estado
    pinMode(25, INPUT_PULLDOWN);

    // Inicializar la comunicación I2C con los pines SDA y SCL
    Wire.begin(OLED_SDA, OLED_SCL);
    
    pinMode(ROTARY_ENCODER_A_PIN, INPUT);
    pinMode(ROTARY_ENCODER_B_PIN, INPUT);
    pinMode(ROTARY_ENCODER_BUTTON_PIN, INPUT_PULLUP);

    attachInterrupt(digitalPinToInterrupt(ROTARY_ENCODER_A_PIN), handleEncoderInterrupt, CHANGE);
    attachInterrupt(digitalPinToInterrupt(ROTARY_ENCODER_B_PIN), handleEncoderInterrupt, CHANGE);
    attachInterrupt(digitalPinToInterrupt(ROTARY_ENCODER_BUTTON_PIN), handleButtonInterrupt, FALLING);

    TCA9548A(4);
    if(!display2.begin(SSD1306_SWITCHCAPVCC, 0x3C)) { 
    Serial.println(F("SSD1306 allocation failed"));
    for(;;); // No continuar si la pantalla no se inicializa
    }

    display2.clearDisplay();
    display2.display();

    TCA9548A(7);
    // Inicializar la pantalla con la dirección I2C (0x3C es una dirección común para estas pantallas)
    if(!display1.begin(SSD1306_SWITCHCAPVCC, 0x3C)) { 
        Serial.println(F("SSD1306 allocation failed"));
        for(;;); // No continuar si la pantalla no se inicializa
    }

    display1.clearDisplay();
    display1.display();

    // Conectar a la red WiFi
    Serial.print("Connecting to WiFi...");
    WiFi.mode(WIFI_STA);
    WiFi.begin(ssid, password);
    unsigned long startAttemptTime = millis();


    while (WiFi.status() != WL_CONNECTED && millis() - startAttemptTime < 60000) { // Esperar hasta 1 minuto
        mostrarSimboloCarga();
        Serial.print(".");
    }

    if (WiFi.status() != WL_CONNECTED) {
        Serial.println(" failed.");
        mostrarMensajeError();
        while (true); // Detener ejecución si no se puede conectar a WiFi
    } else {
        Serial.println(" connected.");
        wifiConnected = true;
        Serial.print("IP address: ");
        Serial.println(WiFi.localIP());
        frame = 0;
    }

    client.setCACert(spotify_server_cert);

    // Iniciar el cliente NTP
    timeClient.begin();

    Serial.println("Refreshing Access Tokens");
    if (!spotify.refreshAccessToken())
    {
        Serial.println("Failed to get access tokens");
    }

    spotify.getPlayerDetails(printPlayerDetailsToSerial, SPOTIFY_MARKET);
    tiempoCheckvol = millis();
}

void loop() {
  machine.run();
}